## conf/distro/aaeon.conf
```bitbake
require conf/distro/poky.conf

DISTRO = "aaeon"
DISTRO_NAME = "Aaeon distro based on Poky"

SDK_VENDOR = "-aaeonsdk"

MAINTAINER = "Koan Software <info@koansoftware.com>"

TARGET_VENDOR = "-aaeon"
```

## conf/layer.conf
```bitbake
BBPATH .= ":${LAYERDIR}"
BBFILES += " \
    ${LAYERDIR}/recipes-*/*/*.bb \
    ${LAYERDIR}/recipes-*/*/*.bbappend \
"

BBFILE_COLLECTIONS += "aaeon-nvidia"
BBFILE_PATTERN_aaeon-nvidia = "^${LAYERDIR}/"
BBFILE_PRIORITY_aaeon-nvidia = "7"

LAYERVERSION_aaeon-nvidia = "1"

LAYERDEPENDS_aaeon-nvidia = "tegra"

LAYERSERIES_COMPAT_aaeon-nvidia = "dunfell"
```
